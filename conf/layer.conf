## conf/layer.conf
```bitbake
# We have a conf and classes directory, append to BBPATH
BBPATH .= ":${LAYERDIR}"

# We have a recipes directory containing .bb and .bbappend files, add to BBFILES
BBFILES += "${LAYERDIR}/recipes*/*/*.bb \
            ${LAYERDIR}/recipes*/*/*.bbappend"

BBFILE_COLLECTIONS += "rpi-bt-dac"
BBFILE_PATTERN_rpi-bt-dac := "^${LAYERDIR}/"
BBFILE_PRIORITY_rpi-bt-dac = "10"

LAYERSERIES_COMPAT_rpi-bt-dac = "warrior"
```
